## drivers/vibrator/cs40l2x/Kconfig
```kconfig
config MOTOR_CS40L2X
	tristate "Cirrus CS40L2X motor"
	depends on I2C
	default n
	help
	  Say Y to enable MOTOR_CS40L2X
	  You can get support for vibration with
	  cs40l2x driver ic if you enable
	  this config.

config MOTOR_DRV_CS40L2X_PMIC_RESET
	tristate "Cirrus CS40L2X motor using reset pin with PMIC LDO"
	depends on MOTOR_CS40L2X
	default n
	help
	  Say Y to enable MOTOR_DRV_CS40L2X_PMIC_RESET
	  You can get support for ldo reset control.
	  Please check your circuit diagram
	  and enable this if you use regulator.
	  p.s. This will be deleted.

config CS40L2X_SAMSUNG_FEATURE
	bool "Cirrus CS40L2X motor and Samsung feature"
	depends on MOTOR_CS40L2X
	default n
	help
	  Say Y to enable CS40L2X_SAMSUNG_FEATURE
	  codes featured with this comment
	  aren't the original code from cirrus.
	  To use samsung concept, please enable this.

config VIB_NOTIFIER
	bool "VIB notifier support"
	default n
	help
	  If you say yes here you will get support for
	  the VIB status change notification.
	  We send notification to acceleration sensor
	  for data reconciliation
```
